## Documentation/devicetree/bindings/input/touchscreen/apple,z2-touchscreen.yaml
```yaml
# SPDX-License-Identifier: (GPL-2.0 OR BSD-2-Clause)
%YAML 1.2
---
$id: http://devicetree.org/schemas/input/touchscreen/apple,z2-touchscreen.yaml#
$schema: http://devicetree.org/meta-schemas/core.yaml#

title: Apple touchscreens attached using the Z2 protocol.

maintainers:
  - asahi@lists.linux.dev
  - Sasha Finkelstein <fnkl.kernel@gmail.com>

description: A series of touschscreen controllers used in Apple products.

allOf:
  - $ref: touchscreen.yaml#
  - $ref: /schemas/spi/spi-peripheral-props.yaml#

properties:
  compatible:
    const: apple,z2-touchscreen

  label: true

  interrupts-extended:
    maxItems: 1

  reset-gpios:
    maxItems: 1

  firmware-name:
    maxItems: 1

  touchscreen-size-x: true
  touchscreen-size-y: true

required:
  - compatible
  - label
  - interrupts-extended
  - reset-gpios
  - firmware-name
  - touchscreen-size-x
  - touchscreen-size-y

allOf:
  $ref: /schemas/spi/spi-peripheral-props.yaml

additionalProperties: false

examples:
  - |
    #include <dt-bindings/gpio/gpio.h>
    #include <dt-bindings/interrupt-controller/irq.h>

    spi {
            #address-cells = <1>;
            #size-cells = <0>;

            touchscreen@0 {
                    compatible = "apple,z2-touchscreen";
                    reg = <0>;
                    label = "MacBookPro17,1 Touch Bar";
                    spi-max-frequency = <11500000>;
                    reset-gpios = <&pinctrl_ap 139 0>;
                    interrupts-extended = <&pinctrl_ap 194 IRQ_TYPE_EDGE_FALLING>;
                    firmware-name = "apple/dfrmtfw-j293.bin";
                    touchscreen-size-x = <23045>;
                    touchscreen-size-y = <640>;
            };
    };

...
```

## drivers/startablet/Kconfig
```kconfig
menu "LGE STAR Tablet Device Drivers"

config STARTABLET_MUIC
    bool "Star Tablet Muic Driver"
    default y
    depends on MACH_STARTABLET
    help
     Support for muic driver.

config STARTABLET_RFKILL
    bool "Star Tablet RFKill Driver"
    default y
    depends on MACH_STARTABLET && RFKILL_INPUT
    help
     Support for rfkill driver.

config STARTABLET_XMM6160
	bool "Star Tablet with CP xmm6160"
    default n
    depends on MACH_STARTABLET
    help
     Support for dummy config for xmm6160.

config STARTABLET_GPS
    bool "Star Tablet GPS Driver"
    default y
    depends on MACH_STARTABLET
    help
     Support for GPS driver.

config STARTABLET_GPS_BCM4751
	bool "Star Tablet GPS BCM4751"
	default n
    depends on STARTABLET_GPS && MACH_STARTABLET
    help
     Support for GPS driver for xmm6160 only.

config STARTABLET_HEADSET_DET
        bool "Star Headset Detection Driver"
        default n
        depends on MACH_STARTABLET
        help
         Suport for headset detection driver.

config STAR_RIL
    bool "Star RIL Driver"
    default y
    depends on MACH_STARTABLET
    help
     Suport for IFX MUX & SPI.

config SPI_MDM6600
	tristate "SPI MDM6600 from Qualcomm"
	depends on MACH_STARTABLET
	help
	Enable this driver to support MDM6600 Modem

config RINETWORK_DRIVER
	bool "Raw ip network driver"
	default y
	depends on MACH_STARTABLET
	help
	  Support for raw ip network driver.

config STARTABLET_ECHO
    bool "Star Tablet Echo Cancel Driver"
    default n
    depends on MACH_STARTABLET
    help
     Support for echo cancel driver.

config STARTABLET_BATTERY
    bool "Star Tablet Battery Driver"
    default n
    depends on MACH_STARTABLET
    help
     Support for battery driver.

config STARTABLET_TOUCHKEY
    bool "Star Tablet TOUCHKEY Driver"
    default y
    depends on MACH_STARTABLET && MACH_STARTABLET_REV_A1
    help
     Support for TOUCHKEY driver.

config STARTABLET_MISC
    bool "Star Tablet MISC Driver"
    default n
    depends on MACH_STARTABLET
    help
     Support for MISC driver.

config STARTABLET_ALS
    bool "Star Tablet ALS Driver"
    default n
    depends on MACH_STARTABLET
    help
     Support for ALS driver.

config STARTABLET_CAMERA_FLASH
        bool "Star Camera Flash LED Test"
        default y
        depends on MACH_STARTABLET
        help
         Suport for Camera flash LED Q-test.

config TOUCHSCREEN_ATMEL_MAXTOUCH
	tristate "Atmel maXTouch based touchscreen: I2C Interface"
	depends on I2C
	default y
	help
	   To compile this driver as a module, choose M here: the
	   module will be called atmel_tsadcc.


source "drivers/net/wireless/bcm4329.lge/Kconfig"

endmenu
```
