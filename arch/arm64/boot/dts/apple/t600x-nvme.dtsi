// SPDX-License-Identifier: GPL-2.0+ OR MIT
/*
 * NVMe related devices for Apple T600x SoCs.
 *
 * Copyright The Asahi Linux Contributors
 */

	die_node(ans_mbox): mbox@38f408000 {
		compatible = "apple,t6000-asc-mailbox", "apple,asc-mailbox-v4";
		reg = <0x3 0x8f408000 0x0 0x4000>;
		interrupt-parent = <&aic>;
		interrupts = <AIC_IRQ DIE_NO 1069 IRQ_TYPE_LEVEL_HIGH>,
			<AIC_IRQ DIE_NO 1070 IRQ_TYPE_LEVEL_HIGH>,
			<AIC_IRQ DIE_NO 1071 IRQ_TYPE_LEVEL_HIGH>,
			<AIC_IRQ DIE_NO 1072 IRQ_TYPE_LEVEL_HIGH>;
		interrupt-names = "send-empty", "send-not-empty",
			"recv-empty", "recv-not-empty";
		power-domains = <&die_node(ps_ans2)>;
		#mbox-cells = <0>;
	};

	die_node(sart): sart@393c50000 {
		compatible = "apple,t6000-sart", "apple,sart3";
		reg = <0x3 0x93c50000 0x0 0x10000>;
		power-domains = <&die_node(ps_ans2)>;
	};

	die_node(nvme): nvme@393cc0000 {
		compatible = "apple,t6000-nvme-ans2", "apple,nvme-ans2";
		reg = <0x3 0x93cc0000 0x0 0x40000>, <0x3 0x8f400000 0x0 0x4000>;
		reg-names = "nvme", "ans";
		interrupt-parent = <&aic>;
		/* The NVME interrupt is always routed to die */
		interrupts = <AIC_IRQ 0 1613 IRQ_TYPE_LEVEL_HIGH>;
		mboxes = <&die_node(ans_mbox)>;
		apple,sart = <&die_node(sart)>;
		power-domains = <&die_node(ps_ans2)>,
			<&die_node(ps_apcie_st_sys)>,
			<&die_node(ps_apcie_st1_sys)>;
		power-domain-names = "ans", "apcie0", "apcie1";
		resets = <&die_node(ps_ans2)>;
	};
